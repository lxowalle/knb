## components/tests/Kconfig
```kconfig
menu "tests config"
    config TESTS_ENABLE
        bool "Enable tests component"
        default y
        help
            Enable include static lib(from gcc)
endmenu
```

## components/third_party/Kconfig
```kconfig
menuconfig THIRD_PARTY_ENABLE
    bool "Enable third party"
    default y

    menuconfig FFMPEG_ENABLE
        bool "Enable ffmpeg"
        default n
        depends on THIRD_PARTY_ENABLE

    menuconfig PJSIP_ENABLE
        bool "Enable pjsip"
        default n
        depends on THIRD_PARTY_ENABLE

        config PJSIP_USE_DYNAMIC_LIB
            bool "Compile pjsip with shared lib (default use shared lib)"
            default y
            depends on PJSIP_ENABLE

        config PJSIP_VIDEO_ENABLE
            bool "Enable pjsip video(depends ffmpeg)"
            default n
            depends on PJSIP_ENABLE
```
